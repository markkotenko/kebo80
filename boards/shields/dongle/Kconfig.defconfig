## boards/shields/dongle/Kconfig.defconfig
```kconfig
if SHIELD_DONGLE

config ZMK_KEYBOARD_NAME
    default "kebo80_dongle"

config ZMK_SPLIT
    default y

config ZMK_SPLIT_ROLE_CENTRAL
    default y

config ZMK_SPLIT_BLE_CENTRAL_PERIPHERALS
    default 1

config BT_MAX_CONN
    default 4

config BT_MAX_PAIRED
    default 4

config ZMK_USB
    default y

endif
```

## boards/shields/kebo80_dongle/Kconfig.defconfig
```kconfig
if SHIELD_KEBO80_DONGLE

config KEBO80
    default "Kebo80"

config ZMK_SPLIT
    default y

config ZMK_SPLIT_ROLE_CENTRAL
    default y

config ZMK_SPLIT_ROLE_PERIPHERAL
    default n

config ZMK_SPLIT_BLE_CENTRAL_PERIPHERALS
    default 1

config BT_MAX_CONN
    default 4

config BT_MAX_PAIRED
    default 4

config USB
    default y

config ZMK_USB
    default y

endif
```
